/*
  SparkFun SPARTN test example sketch

  This example demonstrates how to parse a u-blox SPARTN data stream

  License: MIT. Please see LICENSE.md for more details
*/

#include <SparkFun_Extensible_Message_Parser.h> //http://librarymanager/All#SparkFun_Extensible_Message_Parser

//----------------------------------------
// Constants
//----------------------------------------

// Build the table listing all of the parsers
SEMP_PARSER_DESCRIPTION * parserTable[] =
{
    &sempSpartnParserDescription
};
const int parserCount = sizeof(parserTable) / sizeof(parserTable[0]);

const char * const parserNames[] =
{
    "SPARTN parser"
};
const int parserNameCount = sizeof(parserNames) / sizeof(parserNames[0]);

// Provide some valid and invalid SPARTN messages
const uint8_t rawDataStream[] =
{
    // Invalid data - must skip over
    0, 1, 2, 3, 4, 5, 6, 7,                         //     0

/*
 * https://github.com/u-blox/ubxlib/blob/master/common/spartn/test/u_spartn_test_data.c
 * Some SPARTN test frames, capture from an MQTT topic by the ever helpful
 * Phil Dubach and converted from the binary file using
 * http://tomeko.net/online_tools/file_to_hex.php.
 */
    // OCB 0
    0x73, 0x00, 0x16, 0x69, 0x08, 0xBF, 0x33, 0xD0, 0x78, 0x6C, 0x2D, 0x48, 0x2A, 0x18, 0xF0, 0xC0,
    0x3E, 0x1D, 0x9C, 0x37, 0x7E, 0x9A, 0x5E, 0xE8, 0x39, 0xC6, 0x0E, 0xBD, 0xDE, 0xA9, 0x7D, 0x43,
    0xB9, 0x17, 0x96, 0xC7, 0x04, 0xAF, 0x9A, 0x4B, 0xBF, 0x70, 0x65, 0xC3, 0x66, 0x80, 0xCA, 0x45,
    0x20, 0x16, 0x41, 0xA4, 0x14, 0x2B, 0x5B, 0xD4, 0x11, 0x6F, 0x64,

    // OCB 0 - invalid header CRC
    0x73, 0x01, 0x16, 0x69, 0x08, 0xBF, 0x33, 0xD0, 0x78, 0x6C, 0x2D, 0x48, 0x2A, 0x18, 0xF0, 0xC0,
    0x3E, 0x1D, 0x9C, 0x37, 0x7E, 0x9A, 0x5E, 0xE8, 0x39, 0xC6, 0x0E, 0xBD, 0xDE, 0xA9, 0x7D, 0x43,
    0xB9, 0x17, 0x96, 0xC7, 0x04, 0xAF, 0x9A, 0x4B, 0xBF, 0x70, 0x65, 0xC3, 0x66, 0x80, 0xCA, 0x45,
    0x20, 0x16, 0x41, 0xA4, 0x14, 0x2B, 0x5B, 0xD4, 0x11, 0x6F, 0x64,

    // OCB 0 - invalid CRC
    0x73, 0x00, 0x16, 0x69, 0x08, 0xBF, 0x33, 0xD0, 0x78, 0x6C, 0x2D, 0x48, 0x2A, 0x18, 0xF0, 0xC0,
    0xFF, 0x1D, 0x9C, 0x37, 0x7E, 0x9A, 0x5E, 0xE8, 0x39, 0xC6, 0x0E, 0xBD, 0xDE, 0xA9, 0x7D, 0x43,
    0xB9, 0x17, 0x96, 0xC7, 0x04, 0xAF, 0x9A, 0x4B, 0xBF, 0x70, 0x65, 0xC3, 0x66, 0x80, 0xCA, 0x45,
    0x20, 0x16, 0x41, 0xA4, 0x14, 0x2B, 0x5B, 0xD4, 0x11, 0x6F, 0x64,

    // GAD 0
    0x73, 0x04, 0x5F, 0xEE, 0x05, 0x0A, 0xF0, 0x6C,
    0x25, 0x08, 0x16, 0xE5, 0xF1, 0x12, 0xCD, 0xD9, 0x4B, 0x42, 0x7A, 0xA0, 0xB5, 0x19, 0x45, 0x44,
    0x1B, 0xFE, 0x7F, 0xEB, 0x73, 0x51, 0x7B, 0x06, 0x8B, 0xAB, 0x2B, 0x84, 0xA1, 0x5D, 0xB2, 0xD6,
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    0x1B, 0x36, 0xFA, 0xAC,

    // Invalid data - must skip over
    0, 1, 2, 3, 4, 5, 6, 7,                         //     0

    // HPAC 0
    0x73, 0x03, 0x12, 0x6C, 0x08, 0xBF, 0x33, 0xD0, 0xF0, 0x6C, 0x2E, 0x88, 0xFA, 0xE5, 0x9B, 0x61,
    0x1B, 0x55, 0x79, 0x31, 0x7C, 0x12, 0x89, 0xE6, 0xE6, 0x91, 0x39, 0xA4, 0x65, 0x70, 0xC4, 0xB7,
    0xDD, 0x01, 0xE0, 0x64, 0xFE, 0x15, 0xED, 0x9C, 0x0C, 0x3B, 0xC0, 0xBE, 0xA9, 0x1A, 0xF6, 0xB6,
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    0x71, 0x5E, 0x8D,

};

// Number of bytes in the rawDataStream
#define RAW_DATA_BYTES      (sizeof(rawDataStream) / sizeof(rawDataStream[0]))

// Account for the largest SPARTN messages
#define BUFFER_LENGTH   1100

//----------------------------------------
// Locals
//----------------------------------------

uint32_t dataOffset;
SEMP_PARSE_STATE *parse;

//----------------------------------------
// Test routine
//----------------------------------------

// Initialize the system
void setup()
{
    delay(1000);

    Serial.begin(115200);
    Serial.println();
    Serial.println("SPARTN_Test example sketch");
    Serial.println();

    // Initialize the parser
    size_t bufferLength = sempGetBufferLength(parserTable, parserCount, BUFFER_LENGTH);
    uint8_t * buffer = (uint8_t *)malloc(bufferLength);
    parse = sempBeginParser("SPARTN_Test", parserTable, parserCount,
                            buffer, bufferLength, processMessage);
    if (!parse)
        reportFatalError("Failed to initialize the parser");

    // Obtain a raw data stream from somewhere
    Serial.printf("Raw data stream: %d bytes\r\n", RAW_DATA_BYTES);

    // The raw data stream is passed to the parser one byte at a time
    sempEnableDebugOutput(parse);
    for (dataOffset = 0; dataOffset < RAW_DATA_BYTES; dataOffset++)
        // Update the parser state based on the incoming byte
        sempParseNextByte(parse, rawDataStream[dataOffset]);

    // Done parsing the data
    sempStopParser(&parse);
    free(buffer);
    Serial.printf("All done\r\n");
}

// Main loop processing after system is initialized
void loop()
{
    // Nothing to do here...
}

// Call back from within parser, for end of message
// Process a complete message incoming from parser
void processMessage(SEMP_PARSE_STATE *parse, uint16_t type)
{
    static bool displayOnce = true;
    uint8_t messageType;
    uint32_t offset;

    // Display the raw message
    Serial.println();
    offset = dataOffset + 1 - parse->length;
    const char *typeName[] = {
        "OCB",
        "HPAC",
        "GAD",
        "BPAC",
        "EAS"
    };
    messageType = sempSpartnGetMessageType(parse);
    Serial.printf("Valid SPARTN message, type %d (%s), subtype %d : %d bytes at 0x%08lx (%ld)\r\n",
                  messageType,
                  messageType <= 4 ? typeName[messageType] : "TBD / Proprietary",
                  sempSpartnGetMessageSubType(parse),
                  parse->length, offset, offset);
    dumpBuffer(parse->buffer, parse->length);

    // Display the parser state
    if (displayOnce)
    {
        displayOnce = false;
        Serial.println();
        sempPrintParserConfiguration(parse, &Serial);
    }
}

// Display the contents of a buffer
void dumpBuffer(const uint8_t *buffer, uint16_t length)
{
    int bytes;
    const uint8_t *end;
    int index;
    uint32_t offset;

    end = &buffer[length];
    offset = 0;
    while (buffer < end)
    {
        // Determine the number of bytes to display on the line
        bytes = end - buffer;
        if (bytes > (16 - (offset & 0xf)))
            bytes = 16 - (offset & 0xf);

        // Display the offset
        Serial.printf("0x%08lx: ", offset);

        // Skip leading bytes
        for (index = 0; index < (offset & 0xf); index++)
            Serial.printf("   ");

        // Display the data bytes
        for (index = 0; index < bytes; index++)
            Serial.printf("%02x ", buffer[index]);

        // Separate the data bytes from the ASCII
        for (; index < (16 - (offset & 0xf)); index++)
            Serial.printf("   ");
        Serial.printf(" ");

        // Skip leading bytes
        for (index = 0; index < (offset & 0xf); index++)
            Serial.printf(" ");

        // Display the ASCII values
        for (index = 0; index < bytes; index++)
            Serial.printf("%c", ((buffer[index] < ' ') || (buffer[index] >= 0x7f)) ? '.' : buffer[index]);
        Serial.printf("\r\n");

        // Set the next line of data
        buffer += bytes;
        offset += bytes;
    }
}

// Print the error message every 15 seconds
void reportFatalError(const char *errorMsg)
{
    while (1)
    {
        Serial.print("HALTED: ");
        Serial.print(errorMsg);
        Serial.println();
        sleep(15);
    }
}
