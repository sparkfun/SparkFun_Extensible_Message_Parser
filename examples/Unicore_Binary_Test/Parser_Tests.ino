/*
  SparkFun Unicore binary test example sketch

  This example demonstrates how to parse a Unicore Binary data stream

  License: MIT. Please see LICENSE.md for more details
*/

#include <SparkFun_Extensible_Message_Parser.h> //http://librarymanager/All#SparkFun_Extensible_Message_Parser

//----------------------------------------
// Constants
//----------------------------------------

// Build the table listing all of the parsers
const SEMP_PARSER_DESCRIPTION * parserTable[] =
{
    &sempUnicoreBinaryParserDescription
};
const int parserCount = sizeof(parserTable) / sizeof(parserTable[0]);

// Provide some valid and invalid Unicore messages
const uint8_t rawDataStream[] =
{
    0xaa, 0x44, 0xb5, 0x5c, 0x46, 0x08, 0x78, 0x00, //   0
    0x00, 0xc9, 0x01, 0x00, 0xa0, 0x0f, 0x00, 0x00,
    0x00, 0x00, 0x00, 0x00, 0x00, 0x12, 0x01, 0x00,
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    0x00, 0x00, 0x00, 0x12, 0x82, 0x82, 0x85,

    // Bad CRC
                      0xaa, 0x44, 0xb5, 0x61, 0x46, // 444
    0x08, 0x78, 0x00, 0x00, 0xc9, 0x01, 0x00, 0xd0,
    0xaa, 0xb2, 0x04, 0x00, 0x00, 0x00, 0x00, 0x00,
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    0x00, 0x00, 0x00, 0x13, 0x82, 0x82, 0x85,
};

// Number of bytes in the rawDataStream
#define RAW_DATA_BYTES      sizeof(rawDataStream)

//----------------------------------------
// Locals
//----------------------------------------

// Account for the largest Unicore messages
uint8_t buffer[3079];
uint32_t dataOffset;
SEMP_PARSE_STATE *parse;

//------------------------------------------------------------------------------
// Test routines
//------------------------------------------------------------------------------

//----------------------------------------
// Run the parser tests
//----------------------------------------
void parserTests()
{
    size_t bufferLength;

    // Verify the buffer size
    bufferLength = sempGetBufferLength(parserTable, parserCount);
    if (sizeof(buffer) < bufferLength)
    {
        sempPrintString(output, "Set buffer size to >= ");
        sempPrintDecimalI32Ln(output, bufferLength);
        reportFatalError("Fix the buffer size!");
    }

    // Initialize the parser
    parse = sempBeginParser("Unicore_Test", parserTable, parserCount, buffer,
                            bufferLength, processMessage, output, output);
    if (!parse)
        reportFatalError("Failed to initialize the parser");

    // Obtain a raw data stream from somewhere
    sempPrintString(output, "Raw data stream: ");
    sempPrintDecimalI32(output, RAW_DATA_BYTES);
    sempPrintStringLn(output, " bytes");

    // The raw data stream is passed to the parser one byte at a time
    sempDebugOutputEnable(parse, output);
    for (dataOffset = 0; dataOffset < RAW_DATA_BYTES; dataOffset++)
        // Update the parser state based on the incoming byte
        sempParseNextByte(parse, rawDataStream[dataOffset]);

    // Done parsing the data
    sempStopParser(&parse);
}

//----------------------------------------
// Call back from within parser, for end of message
// Process a complete message incoming from parser
//----------------------------------------
void processMessage(SEMP_PARSE_STATE *parse, uint16_t type)
{
    static bool displayOnce = true;
    uint32_t offset;

    // Display the raw message
    sempPrintLn(output);
    offset = dataOffset + 1 - parse->length;
    sempPrintString(output, "Valid Unicore message: ");
    sempPrintHex0x04x(output, parse->length);
    sempPrintString(output, " (");
    sempPrintDecimalI32(output, parse->length);
    sempPrintString(output, ") bytes at ");
    sempPrintHex0x08x(output, offset);
    sempPrintString(output, " (");
    sempPrintDecimalI32(output, offset);
    sempPrintCharLn(output, ')');
    sempDumpBuffer(output, parse->buffer, parse->length);

    // Display the parser state
    if (displayOnce)
    {
        displayOnce = false;
        sempPrintLn(output);
        sempUnicoreBinaryPrintHeader(parse);
        sempPrintLn(output);
        sempPrintParserConfiguration(parse, output);
    }
}

//----------------------------------------
// Output a character
//
// Inputs:
//   character: The character to output
//----------------------------------------
void output(char character)
{
    // Wait until space is available in the FIFO
    while (Serial.availableForWrite() == 0);

    // Output the character
    Serial.write(character);
}

//----------------------------------------
// Print the error message every 15 seconds
//
// Inputs:
//   errorMsg: Zero-terminated error message string to output every 15 seconds
//----------------------------------------
void reportFatalError(const char *errorMsg)
{
    while (1)
    {
        sempPrintString(output, "HALTED: ");
        sempPrintStringLn(output, errorMsg);
        delay(15 * 1000);   // sleep(15);
    }
}
